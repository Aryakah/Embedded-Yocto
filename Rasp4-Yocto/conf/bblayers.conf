## Rasp4-Yocto/conf/bblayers.conf
```bitbake
# POKY_BBLAYERS_CONF_VERSION is increased each time build/conf/bblayers.conf
# changes incompatibly
POKY_BBLAYERS_CONF_VERSION = "2"

BBPATH = "${TOPDIR}"
BBFILES ?= ""

BBLAYERS ?= " \
  /home/molla/Desktop/Yocto_SRC/poky/meta \
  /home/molla/Desktop/Yocto_SRC/poky/meta-poky \
  /home/molla/Desktop/Yocto_SRC/poky/meta-yocto-bsp \
  /home/molla/Desktop/Yocto_SRC/meta-raspberrypi \
  /home/molla/Desktop/Yocto_SRC/meta-openembedded/meta-oe \
  /home/molla/Desktop/Yocto_SRC/meta-openembedded/meta-python \
  /home/molla/Desktop/Yocto_SRC/meta-openembedded/meta-networking \
  /home/molla/Desktop/Yocto_SRC/meta-localPi \
  /home/molla/Desktop/Yocto_SRC/build/meta-quick \
  /home/molla/Desktop/Yocto_SRC/build/workspace \
  "
```

## Zynq_FPGA_Zybo-z7-7010/Yocto/meta-zybo-custom/conf/distro/zybo-distro.conf
```bitbake
# Zybo custom Yocto distribution
DISTRO = "zybo-distro"
DISTRO_NAME = "Zybo Custom Linux"
DISTRO_VERSION = "1.0"

# Include minimal features and standard Yocto policies

# Use package manager
PACKAGE_CLASSES ?= "package_ipk"

# Allow Xilinx licensed software
LICENSE_FLAGS_ACCEPTED += "xilinx"

# Minimal image defaults
EXTRA_IMAGE_FEATURES = "debug-tweaks"

# Kernel and machine default (adjust if using generic Zynq)
```

## Zynq_FPGA_Zybo-z7-7010/Yocto/meta-zybo-custom/conf/layer.conf
```bitbake
# We have a conf and classes directory, add to BBPATH
BBPATH .= ":${LAYERDIR}"

# We have recipes-* directories, add to BBFILES
BBFILES += "${LAYERDIR}/recipes-*/*/*.bb \
            ${LAYERDIR}/recipes-*/*/*.bbappend"

BBFILE_COLLECTIONS += "meta-zybo-custom"
BBFILE_PATTERN_meta-zybo-custom = "^${LAYERDIR}/"
BBFILE_PRIORITY_meta-zybo-custom = "6"

LAYERDEPENDS_meta-zybo-custom = "core"
LAYERSERIES_COMPAT_meta-zybo-custom = "scarthgap"
```

## Zynq_FPGA_Zybo-z7-7010/Yocto/meta-zybo-custom/conf/machine/zybo-z7.conf
```bitbake
# Zybo Z7-10 Machine Configuration
# Based on Xilinx Zynq-7000 (Zynq-7010 SoC)

require conf/machine/zynq-generic.conf



# Device tree
#KERNEL_DEVICETREE = "zynq-zybo-z7.dtb"

# Boot files

MACHINE_FEATURES += "usb ethernet mmc"
```

## meta-quick/conf/layer.conf
```bitbake
# We have a conf and classes directory, add to BBPATH
BBPATH .= ":${LAYERDIR}"

# We have recipes-* directories, add to BBFILES
BBFILES += "${LAYERDIR}/recipes-*/*/*.bb \
            ${LAYERDIR}/recipes-*/*/*.bbappend"

BBFILE_COLLECTIONS += "meta-quick"
BBFILE_PATTERN_meta-quick = "^${LAYERDIR}/"
BBFILE_PRIORITY_meta-quick = "6"

LAYERDEPENDS_meta-quick = "core"
LAYERSERIES_COMPAT_meta-quick = "scarthgap"
```
